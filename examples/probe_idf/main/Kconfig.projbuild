## examples/probe_idf/main/Kconfig.projbuild
```kconfig
menu "MotorControl-RS standalone board"
    config MOTORCONTROLRS_RS485_TX_PIN
        int "RS485 UART2 TX pin"
        range 0 48
        default 47
        help
            GPIO19 and GPIO20 are reserved for the USB console.
    config MOTORCONTROLRS_RS485_RX_PIN
        int "RS485 UART2 RX pin"
        range 0 48
        default 48
        help
            GPIO19 and GPIO20 are reserved for the USB console.
    config MOTORCONTROLRS_RS485_DE_PIN
        int "Combined DE/RE pin"
        range 0 48
        default 21
        help
            GPIO19 and GPIO20 are reserved for the USB console.
    config MOTORCONTROLRS_DE_ACTIVE_HIGH
        bool "High selects transmit"
        default y
    config MOTORCONTROLRS_RECEIVER_DISABLED_DURING_TX
        bool "Declared topology disables local receiver during TX"
        default y
endmenu
```

## examples/probe_idf/sdkconfig.defaults
```kconfig
CONFIG_IDF_TARGET="esp32s3"
CONFIG_ESPTOOLPY_FLASHSIZE_16MB=y
CONFIG_ESPTOOLPY_FLASHMODE_QIO=y
CONFIG_ESPTOOLPY_FLASHFREQ_80M=y
CONFIG_ESP_DEFAULT_CPU_FREQ_MHZ_240=y
CONFIG_PARTITION_TABLE_CUSTOM=y
CONFIG_PARTITION_TABLE_CUSTOM_FILENAME="../common/partitions_16mb.csv"
CONFIG_SPIRAM=y
CONFIG_SPIRAM_MODE_OCT=y
CONFIG_SPIRAM_SPEED_80M=y
CONFIG_SPIRAM_BOOT_INIT=y
CONFIG_SPIRAM_USE_MALLOC=y
CONFIG_SPIRAM_IGNORE_NOTFOUND=n
CONFIG_SPIRAM_ALLOW_BSS_SEG_EXTERNAL_MEMORY=n
CONFIG_FREERTOS_HZ=1000
CONFIG_FREERTOS_GENERATE_RUN_TIME_STATS=y
CONFIG_FREERTOS_RUN_TIME_STATS_USING_ESP_TIMER=y
CONFIG_FREERTOS_TASK_CREATE_ALLOW_EXT_MEM=n
CONFIG_PM_ENABLE=n
CONFIG_GPTIMER_ISR_CACHE_SAFE=n
CONFIG_GPTIMER_ISR_HANDLER_IN_IRAM=y
CONFIG_ESP_CONSOLE_USB_SERIAL_JTAG=y
CONFIG_LOG_DEFAULT_LEVEL_NONE=y
CONFIG_BOOTLOADER_LOG_LEVEL_NONE=y
```
